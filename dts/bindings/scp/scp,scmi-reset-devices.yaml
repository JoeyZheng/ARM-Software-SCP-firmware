## dts/bindings/scp/scp,scmi-reset-devices.yaml
```yaml
# Arm SCP/MCP Software
# Copyright (c) 2022-2023, Linaro Ltd and Contributors. All rights reserved.
#
# SPDX-License-Identifier: BSD-3-Clause

description: SCP SCMI reset table configuration

compatible: "scp,scmi-reset-devices"

include: base.yaml

properties: 
    label: 
      required: true
      description: name of this table instance. Used to generete c-code.

child-binding:
    description: 
      Table of reset devices by a SCMI agent. 
      Order of declaration forms order in table, and ID required to access.

    properties:
        scp-ids:
          type: phandle-array
          description: SCP ID referring to the reset device being controlled
          required: true

        reset-perms:
          type: int
          required: true
          description: SCMI reset permissions flags

        elem-idx: 
           type: int
           description: device array element index. 
           required: true
```

## dts/bindings/scp/scp,scmi-system-power.yaml
```yaml
# Arm SCP/MCP Software
# Copyright (c) 2022-2023, Linaro Ltd and Contributors. All rights reserved.
#
# SPDX-License-Identifier: BSD-3-Clause

description: SCP SCMI system power control configuration

compatible: "scp,scmi-system-power"

include: base.yaml

properties:
    system-view: 
        type: int
        required: true
        description: SCP index value indicating the SCP SCMI system view

    system-suspend:
        type: int
        required: true
        description: SCP value indicating the system suspend state.

    wakeup-state:
        type: int
        required: false
        description: If OSPM view can be set for the wakeup composite state value

    timeout-us:
        type: int
        required: true
        description: Graceful timeout period in uS to allow for command completion

    scp-ids:
        type: phandle-array
        required: false
        description:
            List of SCP IDs, for the optional alarm ID and  wakeup power domain ID, selected by name.

    scp-id-names:
        type: string-array
        required: false
        description: 
            Names of the SCP IDs in this component. May be "alarm" or "wakeup"
```

## dts/bindings/scp/scp,scmi.yaml
```yaml
# Arm SCP/MCP Software
# Copyright (c) 2022-2023, Linaro Ltd and Contributors. All rights reserved.
#
# SPDX-License-Identifier: BSD-3-Clause

description: SCP SCMI base configuration

compatible: "scp,scmi"

include: base.yaml

properties:
    protocol-count-max:
        description: Maximum protocols for this SCMI server
        required: true
        type: int

    vendor-identifier:
        required: true
        type: string

    sub-vendor-identifier:
        required: true
        type: string

    psci-dis-protocols:
        description: PCSI disallowed protocols
        required: false
        type: array

    agent-table: 
        description: array of phandle references to agents in the system
        type: phandles
        required: true

    clock-max-pending-trans:
        description:
            Maximum pending clock transactions permitted
        type: int
        required: true
        
```

## dts/bindings/scp/scp,sds-region.yaml
```yaml
# Arm SCP/MCP Software
# Copyright (c) 2022-2023, Linaro Ltd and Contributors. All rights reserved.
#
# SPDX-License-Identifier: BSD-3-Clause

description: SCP SDS region descriptions

compatible: "scp,sds-region"

include: base.yaml

properties:
  region-idx: 
    required: true
    type: int
    description: SCP region index for this element

  reg:
    required: true
    description: Base address and size for this region
  
```

## dts/bindings/scp/scp,sds.yaml
```yaml
# Arm SCP/MCP Software
# Copyright (c) 2022-2023, Linaro Ltd and Contributors. All rights reserved.
#
# SPDX-License-Identifier: BSD-3-Clause

description: SCP SDS element descriptor table. Series of data elements in the SDS area

compatible: "scp,sds"

include: base.yaml

properties:
  label: 
    required: true

  table-idx:
    description: descriptor array table index for this SDS data element
    required: true
    type: int

  data-id-size:
    description: Array containing data id and size for this SDS data element.
    required: true
    type: array
    
  region-id:
    description: SDS memory region identifier this SDS data table resides in..
    required: true
    type: int

  finalize:
    description: Flag to finalise SDS element.
    required: false
    type: boolean
```

## dts/bindings/scp/scp,sensor.yaml
```yaml
# Arm SCP/MCP Software
# Copyright (c) 2022-2023, Linaro Ltd and Contributors. All rights reserved.
#
# SPDX-License-Identifier: BSD-3-Clause

description: SCP sensor configuration. Create tables of SCP framework IDs to reference sensors.
             Each table is named. Tables are formed into a table of tables for reference from 
             the platform specific configuration code.

compatible: "scp,sensor"

include: base.yaml

properties:
    label:
        required: true
        description: name of this sensor table. used to generate C-code

    table-idx: 
        type: int
        required: true
        description: Index of this table in the table list.

child-binding:
    description: Individual sensor definitions

    properties:

        elem-idx:
            type: int
            required: true
            description: table element index for the sensor to be referenced in the API.

        sensor-name:
            type: string
            required: false
            description: Name of the sensor 
            
        scp-ids:
            type: phandle-array
            description: list of SCP IDs for the sensor configuration.
            required: true            

        scp-id-names: 
            type: string-array
            required: true
            description: names of the SCP IDs. Permitted are "driver", "driver_api", 
                         "notification" and "trip_point_api"
```

## dts/bindings/scp/scp,statistics.yaml
```yaml
# Arm SCP/MCP Software
# Copyright (c) 2022-2023, Linaro Ltd and Contributors. All rights reserved.
#
# SPDX-License-Identifier: BSD-3-Clause

description: SCP statistics 

compatible: "scp,statistics"

include: base.yaml

properties:
  reg:
    required: true
    description: 2 address and size pairs, ordered by SCP stats address, AP stats address.

  scp-ids:
    type: phandle-array
    required: true
    description: contains single phandle ref to scp Framework sub element identifier for 
                 the alarm for periodic updates.
```

## dts/bindings/scp/scp,sys-power-dev.yaml
```yaml
# Arm SCP/MCP Software
# Copyright (c) 2022-2023, Linaro Ltd and Contributors. All rights reserved.
#
# SPDX-License-Identifier: BSD-3-Clause

description: SCP System power device driver

compatible: "scp,sys-power-dev"

include: base.yaml

properties:
  label: 
    description: Name of device object in SCP firmware
    required: true

  scp-ids:
    description: SCP frameworks IDs for ordered for system ppu driver and api
    required: true
    type: phandle-array

  sys-state-table:
    description: reference to a power state table used by the device
    type: phandle
    required: true

  
```

## dts/bindings/scp/scp,sys-power-table.yaml
```yaml
# Arm SCP/MCP Software
# Copyright (c) 2022-2023, Linaro Ltd and Contributors. All rights reserved.
#
# SPDX-License-Identifier: BSD-3-Clause

description: SCP System power state table

compatible: "scp,sys-power-table"

include: base.yaml

properties:
  label: 
    description: Name of table object in SCP firmware
    required: true

  power-states:
    description: Array of power states associated with the state values.
    type: array
    required: true

  power-values:
    description: Values for system power states. 1 value per power-states entry
    type: array
    required: true
```

## dts/bindings/scp/scp,system-power.yaml
```yaml
# Arm SCP/MCP Software
# Copyright (c) 2022-2023, Linaro Ltd and Contributors. All rights reserved.
#
# SPDX-License-Identifier: BSD-3-Clause

description: SCP System power initial configuration

compatible: "scp,system-power"

include: base.yaml

properties:
  soc-wakeup-irq:
    type: int
    required: true

  scp-ids:
     description: Ordered SCP framework IDs,  module ID for driver, element ID for API
     required: true
     type: phandle-array

  init-pwr-state:
    description: Initial system power state.
    type: int
    required: true
  
  
```

## dts/bindings/scp/scp,timer.yaml
```yaml
# Arm SCP/MCP Software
# Copyright (c) 2022-2023, Linaro Ltd and Contributors. All rights reserved.
#
# SPDX-License-Identifier: BSD-3-Clause

description: SCP timer configuration

compatible: "scp,timer"

include: base.yaml

properties:
    label: 
      required: true

    scp-ids:
      description: SCP Framework module or element ID for the driver
      required: true
      type: phandle-array

    timer-irq:
      description: Timer IRQ for the device
      required: true
      type: int

    sub-elem-count:
      description: Number of sub elements associated with the timer.
      required: false
      type: int
```

## dts/bindings/scp/scp,transport.yaml
```yaml
# Arm SCP/MCP Software
# Copyright (c) 2022-2023, Linaro Ltd and Contributors. All rights reserved.
#
# SPDX-License-Identifier: BSD-3-Clause

description: Configure SCP HAL Module used to provide transport for inter-processor messages.
             Each instance represents a single transport channel.

compatible: "scp,transport"

include: base.yaml

properties:
    reg:
      required: false
      description: Out of band mailbox address and size.

    in-band-size:
      required: false
      type: int
      description: in band mailbox size.

    transport-type: 
      required: false
      type: int
      description: Channel transport type (In-band, Out-band, etc.)

    channel-type: 
      required: true
      type: int
      description: Channel role (requester or completer)

    channel-policies:
      required: true
      type: int
      description: Channel policies 

    scp-ids: 
      required: true
      type: phandle-array
      description: Define SCP framework IDs for transport. Define IDs by names.
                   Reqiured names are "driver" and "driver_api". 
                   Optional names are "pd_source" for out-band transport; "signal_api" for non-SCMI channels.

    scp-id-names:
      required: true
      type: string-array
      description: Names of framework IDs. 
                   Permitted values are "driver", "driver_api", "pd_source", "signal_api".
                   
      
```
