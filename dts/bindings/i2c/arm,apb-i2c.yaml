## dts/bindings/i2c/arm,apb-i2c.yaml
```yaml
# SCP firmware, i2c apb module configuration
# Copyright (c) 2023, Linaro Ltd and Contributors. All rights reserved.
#
# SPDX-License-Identifier: BSD-3-Clause

description: I2C hardware device 

compatible: "arm,apb-i2c"

include: base.yaml

properties:
  reg:
    description: Base address for the I2C device
    required: true
    type: array

  irq:
    description: IRQ number for I2C device
    required: true
    type: int
```

## dts/bindings/juno/arm,juno-debug-scp-mod.yaml
```yaml
# Arm SCP/MCP Software
# Copyright (c) 2022-2023, Linaro Ltd and Contributors. All rights reserved.
#
# SPDX-License-Identifier: BSD-3-Clause

description: SCP Juno debug module configuration settings

compatible: "arm,juno-debug-scp-mod"

include: base.yaml

properties:
    scp-ids:
      type: phandle-array
      required: true
      description: 
          Ordered list of SCP IDs listing the element IDS for timer-id, 
          pd-debug-sys-id, pd-big-sstop-id and pd-little-sstop-id
    
    label:
      required: true
      description: name of debug element

    arm,atclk-div-mhz:
      type: int
      required: true
      description: AT clock divider freq in MHz - Juno R0 platform

    arm,atclk-div-mhz-r1r2:
      type: int
      required: true
      description: AT clock divider freq in MHz - Juno R1/R2 platform

    arm,pclk-div:
      type: int
      description: clock divider value for pclk
      required: true

    arm,trace-clk-div-mhz:
      type: int
      description: trace clock divider in MHz
      required: true


    
```

## dts/bindings/juno/arm,juno-ppu.yaml
```yaml
# SCP firmware, juno PPU module configuration
# Copyright (c) 2023, Linaro Ltd and Contributors. All rights reserved.
#
# SPDX-License-Identifier: BSD-3-Clause

description: Configuration table for Juno PPU modules.

compatible: "arm,juno-ppu"

include: base.yaml

properties:
  reg:
    description: Base address for the PPU device
    required: true
    type: array

  scp-ids:
    description: SCP framework module ID for the timer used in the PPU. Set to none if not present.
    required: false
    type: phandle-array

  pd-type:
    description: SCP Power domain type identifier.
    required: false
    type: int

  irq-nums:
    description: Ordered list of 3 irq numbers for wakeup_irq, wakeup_fiq and warm_reset_irq
    required: false
    type: array

  elem-idx: 
    description: table array index for PPU configuration
    required: true
    type: int
```

## dts/bindings/juno/arm,juno-rom.yaml
```yaml
# SCP firmware, juno ROM module
# Copyright (c) 2023, Linaro Ltd and Contributors. All rights reserved.
#
# SPDX-License-Identifier: BSD-3-Clause

description: Configuration information for Juno ROM

compatible: "arm,juno-rom"

include: base.yaml

properties:
  ap-context:
     description: Application Processor memory context area, address and size
     required: true
     type: array

  ram-fw-base:
     description: Firmware RAM base address
     required: true
     type: int
```

## dts/bindings/juno/arm,juno-scc.yaml
```yaml
# Arm SCP/MCP Software
# Copyright (c) 2023, Linaro Ltd and Contributors. All rights reserved.
#
# SPDX-License-Identifier: BSD-3-Clause

description: SCP Juno SCC device
        defines the base address of the SCC registers.

compatible: "arm,juno-scc"

include: base.yaml

properties:
    reg:
      required: true
```

## dts/bindings/scp/fwk-ids/scp,elem-id.yaml
```yaml
# Arm SCP/MCP Software
# Copyright (c) 2022-2023, Linaro Ltd and Contributors. All rights reserved.
#
# SPDX-License-Identifier: BSD-3-Clause

description: SCP software framework module element ID 

compatible: "scp,elem-id"

include: base.yaml

properties:
    "#scp-id-cells":
        type: int
        const: 2

scp-id-cells:
    - mod-idx       # module index
    - elem-idx      # element index
```

## dts/bindings/scp/fwk-ids/scp,mod-id.yaml
```yaml
# Arm SCP/MCP Software
# Copyright (c) 2022-2023, Linaro Ltd and Contributors. All rights reserved.
#
# SPDX-License-Identifier: BSD-3-Clause

description: SCP software framework module ID 

compatible: "scp,mod-id"

include: base.yaml

properties:
    "#scp-id-cells":
        type: int
        const: 1

scp-id-cells:
    - mod-idx       # module index
```

## dts/bindings/scp/fwk-ids/scp,notify-id.yaml
```yaml
# Arm SCP/MCP Software
# Copyright (c) 2022-2023, Linaro Ltd and Contributors. All rights reserved.
#
# SPDX-License-Identifier: BSD-3-Clause

description: SCP software framework Notification ID 

compatible: "scp,notify-id"

include: base.yaml

properties:
    "#scp-id-cells":
        type: int
        const: 2

scp-id-cells:
    - mod-idx       # module index
    - ntfy-idx       # notify index
```

## dts/bindings/scp/fwk-ids/scp,sub-elem-id.yaml
```yaml
# Arm SCP/MCP Software
# Copyright (c) 2022-2023, Linaro Ltd and Contributors. All rights reserved.
#
# SPDX-License-Identifier: BSD-3-Clause

description: SCP software framework module sub-element ID 

compatible: "scp,sub-elem-id"

include: base.yaml

properties:
    "#scp-id-cells":
        type: int
        const: 3

scp-id-cells:
    - mod-idx       # module index
    - elem-idx      # element index
    - sub-elem-idx  # sub element index
```

## dts/bindings/scp/scp,debug.yaml
```yaml
# Arm SCP/MCP Software
# Copyright (c) 2022-2023, Linaro Ltd and Contributors. All rights reserved.
#
# SPDX-License-Identifier: BSD-3-Clause

description: SCP software debug module 

compatible: "scp,debug"

include: base.yaml

properties:
    scp-ids:
        type: phandle-array
        required: true
        description: ordered list defining the Driver ID and API ID for the platform debug module.

    label:
        type: string
        required: true
        description: name of the debug element
```

## dts/bindings/scp/scp,gtimer.yaml
```yaml
# Arm SCP/MCP Software
# Copyright (c) 2022-2023, Linaro Ltd and Contributors. All rights reserved.
#
# SPDX-License-Identifier: BSD-3-Clause

description: SCP Generic Timer configuration

compatible: "scp,gtimer"

include: base.yaml

properties:
  label: 
    required: true

  timer-addr:
    description: Address of the devices timer register
    type: array
    required: true

  counter-addr:
    description: Address of the devices counter register
    type: array
    required: true

  control-addr:
    description: Address of the devices control register
    type: array
    required: true

  frequency: 
    description: Frequency in Hz that the timer ticks at
    required: true
    type: int

  scp-ids: 
    description: SCP framework Element ID for clock that this device depends on
    required: false
    type: phandle-array
```

## dts/bindings/scp/scp,mhu.yaml
```yaml
# Arm SCP/MCP Software
# Copyright (c) 2022-2023, Linaro Ltd and Contributors. All rights reserved.
#
# SPDX-License-Identifier: BSD-3-Clause

description: SCP Message handling unit configuration. 
             Configure a single message handling instance. Multiple instances used to create an MHU table.

compatible: "scp,mhu"

include: base.yaml

properties:
  reg:
    required: true
    description: ordered list of 2 addresses, without size parameters 
                First SCP message Out base address. 
                Second AP message In base address.

  irq: 
    required: true
    type: int
    description:  Interrupt muber for this message handler

  elem-idx:
    required: true
    type: int
    description: SCP firmware table entry index

  sub-elem-count: 
    required: true
    type: int
    description: Number of associated sub-elements 
```

## dts/bindings/scp/scp,mock-clock.yaml
```yaml
# Arm SCP/MCP Software
# Copyright (c) 2022-2023, Linaro Ltd and Contributors. All rights reserved.
#
# SPDX-License-Identifier: BSD-3-Clause

description: SCP Mock Clock

compatible: "scp,mock-clock"

include: base.yaml

properties:
    label:
      required: true

    rate-table:
      description: Table of frequency values
      type: array
      required: true

    default-rate:
      description: Default rate used for clock
      type: int
      required: true
```

## dts/bindings/scp/scp,mock-psu.yaml
```yaml
# Arm SCP/MCP Software
# Copyright (c) 2022-2023, Linaro Ltd and Contributors. All rights reserved.
#
# SPDX-License-Identifier: BSD-3-Clause

description: SCP Mock PSU Configuration

compatible: "scp,mock-psu"

include: base.yaml

properties:
  label: 
    required: true

  elem-idx:
    description: SCP PSU software module index for this element
    type: int
    required: true

  scp-ids:
    description: optional SCP Framework ID for Async alarm
    required: false
    type: phandle-array

  default-voltage:
    description: Default voltage for PSU element
    required: true
    type: int

  default-enabled:
    description: Set if PSU element is enabled by default
    required: false
    type: boolean
```

## dts/bindings/scp/scp,mod-arm-apb-i2c.yaml
```yaml
# SCP firmware, i2c SCP module configuration
# Copyright (c) 2023, Linaro Ltd and Contributors. All rights reserved.
#
# SPDX-License-Identifier: BSD-3-Clause

description: I2C SCP module 

compatible: "scp,mod-arm-apb-i2c"

include: base.yaml

properties:
    scp-ids:  
      description: SCP IDs for i2c modules. Required clock ID, driver ID and API Ids
      required: true
      type: phandle-array

    scp-id-names:
      description: SCP ID names, required "timer", "driver", "api"
      required: true
      type: string-array

    scp,hardware:
      description: Reference to the underlying I2C hardware. 
      required: true
      type: phandle

    label:
      description: Name of i2c device
      required: false
```

## dts/bindings/scp/scp,mod-arm-pl011.yaml
```yaml
# Arm SCP/MCP Software
# Copyright (c) 2022-2023, Linaro Ltd and Contributors. All rights reserved.
#
# SPDX-License-Identifier: BSD-3-Clause

description: SCP module for ARM PL011 UART

compatible: "scp,mod-arm-pl011"

properties:
    scp,hardware:
      type: phandle
      description: Phandle reference to the underlying PL011 hardware.
      required: true

    scp-ids:
      type: phandle-array
      required: true
      description: SCP IDs for the power domain of the component.
```

## dts/bindings/scp/scp,mod-juno-reset.yaml
```yaml
# Arm SCP/MCP Software
# Copyright (c) 2023, Linaro Ltd and Contributors. All rights reserved.
#
# SPDX-License-Identifier: BSD-3-Clause

description: defines configuration of a device 
            in the table of reset domain elements

compatible: "scp,mod-juno-reset"

include: base.yaml

properties:
  scp,hardware:
    required: true
    description: base address of hardware device providing reset register
    type: phandle

  label:
    required: true
    description: name of reset domain device

  elem-idx: 
    required: true
    type: int
    description: table element index
```

## dts/bindings/scp/scp,pd-mask-table.yaml
```yaml
# Arm SCP/MCP Software
# Copyright (c) 2022-2023, Linaro Ltd and Contributors. All rights reserved.
#
# SPDX-License-Identifier: BSD-3-Clause

description: SCP Power Domain mask table

compatible: "scp,pd-mask-table"

include: base.yaml

properties:
  label: 
    description: Name of table object in SCP firmware
    required: true

  pd-states:
    description: Array of PD states associated with the mask values.
    type: array
    required: true

  mask-values:
    description: Mask values for power domain states. 1 value per pd-states entry
    type: array
    required: true
```

## dts/bindings/scp/scp,power-domain.yaml
```yaml
# Arm SCP/MCP Software
# Copyright (c) 2022-2023, Linaro Ltd and Contributors. All rights reserved.
#
# SPDX-License-Identifier: BSD-3-Clause

description: SCP Power Domain Configuration

compatible: "scp,power-domain"

include: base.yaml

properties:
  label: 
    required: true

  pd-type:
    description: Power Domain type
    required: true
    type: int

  pd-idx:
    description: SCP PD software module index for this element
    type: int
    required: true

  pd-parent:
    description: reference to parent power domain. Default to none.
    type: phandle
    required: false

  scp-ids:
    description: Array of SCP framework IDs; [0] element or module ID for driver, [1] elem ID for api
    required: true
    type: phandle-array

#  driver-id:
#    description: SCP driver / module ID pair or module single id
#    required: true
#    type: array

#  api-id:
#    description: SCP api / module ID pair
#    required: true
#    type: array
  
  allowed-mask-table: 
    description: reference to a table of allowed masks
    required: true
    type: phandle

  disable-state-trans-notifications:
    description: Flag to disable notifications for state transitions
    required: false
    type: boolean
    
```

## dts/bindings/scp/scp,reset-domain-config.yaml
```yaml
# Arm SCP/MCP Software
# Copyright (c) 2022-2023, Linaro Ltd and Contributors. All rights reserved.
#
# SPDX-License-Identifier: BSD-3-Clause

description: SCP Reset Domain Configuration

compatible: "scp,reset-domain-config"

include: base.yaml

properties:
  
  scp-ids:
    required: true
    description: SCP framework ID used for notifications
          Modules that are interested in the status of an auto reset of a
          reset domain will use ID to subscribe to the notification. 
          Present if build is using notifications
    type: phandle-array
```

## dts/bindings/scp/scp,reset-domain-elem.yaml
```yaml
# Arm SCP/MCP Software
# Copyright (c) 2022-2023, Linaro Ltd and Contributors. All rights reserved.
#
# SPDX-License-Identifier: BSD-3-Clause

description: SCP Reset Domain Element Configuration

compatible: "scp,reset-domain-elem"

include: base.yaml

properties:
  label:
    required: true

  elem-idx:
    required: true
    description: element index in table of reset domains
    type: int

  scp-ids:
    required: true
    description: Array of SCP framework IDs, [0] is driver element ID, [1] is driver API ID
    type: phandle-array

  capabilities: 
    required: false
    description: Supported capabilities, see mod_reset_domain_capabilities
    type: int

  modes:
    required: true
    description: Supported modes, see mod_reset_domain_mode
    type: int

  latency:
    required: true
    description: Maximum time (in microseconds) required for the reset to take effect
    type: int
```

## dts/bindings/scp/scp,scmi-agent.yaml
```yaml
# Arm SCP/MCP Software
# Copyright (c) 2022-2023, Linaro Ltd and Contributors. All rights reserved.
#
# SPDX-License-Identifier: BSD-3-Clause

description: SCP SCMI agent configuration

compatible: "scp,scmi-agent"

include: base.yaml

properties:
    label:
        description: Agent Name
        required: true

    agent-type:
        description: SCMI Agent Type
        required: true
        type: int

    agent-idx:
        description: Agent index reference
        required: true
        type: int

    scmi-clock-table:
        description: Table of clocks available for control by this agent
        type: phandle
        required: false

    scmi-reset-table:
        description: Table of reset devices available for control by this agent
        type: phandle
        required: false
```
