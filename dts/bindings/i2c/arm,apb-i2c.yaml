## dts/bindings/scp/scp,scmi-clock-table.yaml
```yaml
# Arm SCP/MCP Software
# Copyright (c) 2022-2023, Linaro Ltd and Contributors. All rights reserved.
#
# SPDX-License-Identifier: BSD-3-Clause

description: SCP SCMI clock table configuration

compatible: "scp,scmi-clock-table"

include: base.yaml

properties:
  label:
    description:
      Name of clock table. Used in C code as object name and reference.
    required: true

child-binding:
    description: 
      Table of clocks controlled by a SCMI agent. 
      Order of declaration forms order in table, and ID required to access.



    properties:
        scp-ids:
          type: phandle-array
          description: SCP ID referring to the clock being controlled
          required: true

        starts-enabled:
          type: boolean
          description: Flag to indicate if this clock is enabled at start of SCMI service.
          required: false
```

## dts/bindings/scp/scp,scmi-perf.yaml
```yaml
# Arm SCP/MCP Software
# Copyright (c) 2022-2023, Linaro Ltd and Contributors. All rights reserved.
#
# SPDX-License-Identifier: BSD-3-Clause

description: SCP SCMI performance module configuration

compatible: "scp,scmi-perf"

include: base.yaml

properties:
      reg:
        description: base address of the performance shared memory area
        required: true

      scp-ids:
        description: SCP sub element ID for the perf fast channel timer
        required: true
        type: phandle-array
      
      fast-chan-rate-limit:
        description: rate limit for fast channel messages
        required: true
        type: int

      perf-domain-indexes: 
        description: Domain indexes for controlled DVFS elements
        required: true
        type: array

       
```

## dts/bindings/scp/scp,scmi-pwr-domain.yaml
```yaml
# Arm SCP/MCP Software
# Copyright (c) 2022-2023, Linaro Ltd and Contributors. All rights reserved.
#
# SPDX-License-Identifier: BSD-3-Clause

description: SCP SCMI power domain configuration.
            Driver and API IDs when debug module is in use

compatible: "scp,scmi-pwr-domain"

include: base.yaml

properties: 
    scp-ids:
        type: phandle-array
        description: ordered pair of SCP IDs referring to the debug power domain and the 
                    debug module                    
        required: true
```
